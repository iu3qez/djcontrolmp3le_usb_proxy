## esp32_p4_midi_proxy/sdkconfig.defaults
```kconfig
# ESP32-P4 Configuration Defaults

# Target chip
CONFIG_IDF_TARGET="esp32p4"

# USB OTG Configuration
# OTG1 as USB Host (for Hercules controller)
# OTG2 as USB Device (for MIDI to PC)
CONFIG_USB_OTG_SUPPORTED=y

# USB (use native ESP-IDF USB support)
# We'll implement TinyUSB integration manually

# FreeRTOS
CONFIG_FREERTOS_HZ=1000
CONFIG_FREERTOS_UNICORE=n

# Serial console
CONFIG_ESP_CONSOLE_UART_BAUDRATE=115200

# Logging
CONFIG_LOG_DEFAULT_LEVEL_INFO=y
CONFIG_LOG_MAXIMUM_LEVEL_VERBOSE=y

# Memory optimization
CONFIG_SPIRAM=y
CONFIG_SPIRAM_SPEED_120M=y

# Debug
CONFIG_COMPILER_OPTIMIZATION_DEBUG=y
```
